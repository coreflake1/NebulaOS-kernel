## kernel/kernel-6.6/module_drivers/drivers/misc/Kconfig
```kconfig
config INGENIC_RSA
        bool "[RSA] Ingenic RSA Driver"
        depends on SOC_X2000 || SOC_X2100 || SOC_M300 || SOC_X2500
        help
                this driver is used to Encrypt/Decrypt by RSA.
        default n

config LINUX_PMEM
        bool "Linux pmem allocator"
        default n

config PMEM_RESERVE_SIZE
        string "reserve size"
        depends on LINUX_PMEM
        default 0M
        help
                set this like 16M, 4096K, 100000[B], 0x5000(B).

config INGENIC_EFUSE_V2
	bool "[Efuse] Ingenic Efuse v2 Driver"
        depends on SOC_X1600
        default n

config INGENIC_EFUSE_V2_WRITABLE
        bool "[Efuse] Ingenic Efuse V2 Writable"
	depends on INGENIC_EFUSE_V2
        default n


config INGENIC_EFUSE_X2000
        bool "[Efuse] Ingenic Efuse Driver"
	depends on SOC_X2000 || SOC_X2100 || SOC_M300 || SOC_X2600 || SOC_AD100
        default n

config INGENIC_EFUSE_WRITABLE
        bool "[Efuse] Ingenic Efuse Writable"
	depends on INGENIC_EFUSE_X2000
        default n

config JZ_EFUSE_X2500
        bool "[Efuse] Ingenic Efuse Driver"
	depends on SOC_X2500
        default n

config BCM_4345C5_RFKILL
	tristate "Bluetooth power control driver for BCM-4345C5 module"
	depends on RFKILL && (MMC_SDHCI_INGENIC || INGENIC_MMC_MMC0 || INGENIC_MMC_MMC1)
	default n
	help
	Creates an rfkill entry in sysfs for power control of Bluetooth
	bcm-xxxx chips.

config NEBULAOS_BACKLIGHT_FINAL_CONTROLLER
	bool "NebulaOS kernel-owned backlight final controller (GPC0/PWM0/PC22)"
	depends on PWM
	depends on BACKLIGHT_CLASS_DEVICE
	default n
	help
	  Post-incident redesign (2026-08-02+) of the backlight hardware
	  discovery work - see this driver's own file header
	  (nebulaos_backlight_final_controller.c) for the full incident
	  writeup and design rationale, and build-work/display-analysis/
	  backlight-path-analysis.txt for the underlying candidate-hardware
	  evidence trail.

	  A single kernel-owned platform driver that is the EXCLUSIVE owner
	  of three candidate backlight hardware resources: GPC0 as a plain
	  GPIO, GPC0 muxed to PWM channel 0's peripheral function, and the
	  candidate enable-GPIO PC22. Structurally prevents the exact
	  incident this redesign follows: probe() NEVER acquires any of the
	  three resources (no devm_gpiod_get()/devm_pwm_get()/
	  pinctrl_select_state() calls outside the explicit runtime state-
	  transition functions), and the shared &pwm controller node's own
	  pinctrl-0 is never touched - GPC0's PWM-function pinmux is instead
	  selected dynamically, only by this driver, only at the moment
	  "pwm-active" is actually entered, via this driver's OWN DT node's
	  pinctrl-names/pinctrl-0 (a state deliberately never named "default"
	  or "init", so the device core's automatic pinctrl_bind_pins() never
	  selects it either - see the driver's file header for the exact
	  pinctrl-ingenic.c/pinctrl core call chain this relies on).

	  Explicit, mutex-serialized state machine: boot-preserve (the only
	  state reachable at boot - zero hardware claimed, bootloader's own
	  GPC0 configuration left completely untouched) -> safe-on (GPC0
	  GPIO output driven HIGH - the live-proven-safe restoration target)
	  -> safe-off-test / pwm-active (both bounded, both only reachable
	  FROM safe-on, both always converge back to safe-on on completion,
	  timeout, error, or explicit disarm). A kernel workqueue watchdog is
	  armed BEFORE every hardware mutation (same ordering already proven
	  correct by CONFIG_NEBULAOS_BACKLIGHT_PROBE_DIAG), independent of
	  any userspace process's lifetime, with a hard 2-second cap on any
	  single operation. Never uses legacy /sys/class/gpio sysfs for
	  anything.

	  Disabled by default - never enable for a production/active-slot
	  build until live hardware testing confirms correct behavior. If
	  unsure, say N.
```

## kernel/kernel-6.6/module_drivers/drivers/pwm/Kconfig
```kconfig
config PWM_INGENIC
        tristate "Ingenic PWM support"
        depends on SOC_X2500
        help
          Generic PWM framework driver for Ingenic soc based
          machines.

          To compile this driver as a module, choose M here: the module
          will be called pwm-ingenic.

config PWM_INGENIC_V2
        tristate "Ingenic PWM V2 support"
        depends on SOC_X2000_V12 || SOC_X2000 || SOC_M300 || SOC_X2100
        help
          Generic PWM framework driver for Ingenic soc based
          machines.
          Support SOCs: X2000,

          To compile this driver as a module, choose M here: the module
          will be called pwm-ingenic.


config PWM_INGENIC_V2_GET_STATE
        bool "Ingenic PWM V2 .get_state hardware readback support"
        depends on PWM_INGENIC_V2
        default n
        help
          NebulaOS PWM state readback patch (2026-08-xx): implements the
          missing .get_state callback for pwm-ingenic-v2.c, which
          previously only implemented .apply. Without .get_state, the
          generic PWM core's one-shot readback at PWM request time
          (drivers/pwm/core.c:pwm_device_request()) leaves a consumer's
          cached state at a synthetic all-zero/disabled value regardless
          of what the hardware is actually doing.

          COMMON_MODE channels (the default - see mode_sel[] in
          pwm-ingenic-v2.c) get an exact enabled/period/duty_cycle/
          polarity readback, agreeing with the .apply path to within one
          hardware tick. DMA_MODE channels (only reachable via a debug
          sysfs store handler, not expected on a real backlight channel)
          have no simple duty/period register - period/duty_cycle are
          reported as 0 and explicitly NOT claimed exact; see the new
          get_state_exact sysfs attribute and the exported
          ingenic_pwm_channel_get_state_is_exact().

          See docs/NEBULAOS_PWM_STATE_READBACK_REPORT.md for the full
          PRESCALE-ambiguity trace and round-trip test results.

          Disabled by default - this project's convention is to never
          silently change an already-shipping driver's behavior until
          live-hardware-qualified. If unsure, say N.

config PWM_INGENIC_V3
        bool "Ingenic V3 PWM support"
        depends on SOC_X1600 || SOC_X2600 || SOC_AD100
        help
          Generic PWM framework driver for ingenic PWM-V3
          machines.

config JZ_PWM_GPIO_TRIGGER
        bool "pwm gpio trigger support"
        depends on PWM_INGENIC_V3
        default n

config PWM_DUMP
    bool "Enable PWM dump feature"
    default y
    help
        Enable this option to generate sysfs attributes for PWM dump.
```

## kernel/kernel-6.6/module_drivers/drivers/video/fbdev/ingenic/fb_stage/Kconfig
```kconfig
menuconfig FB_INGENIC_STAGE
	tristate "Ingenic Framebuffer Driver for stage"
	depends on FB_INGENIC
	select FB_INGENIC_DISPLAYS_STAGE
	select FB_CFB_FILLRECT
	select FB_CFB_COPYAREA
	select FB_CFB_IMAGEBLIT
	help
	  Framebuffer support for the Version 12 DPU SoC.
config HW_COMPOSER_V4L2_M2M
	bool "support composer v4l2mem device"
	depends on FB_INGENIC_STAGE
	select V4L2_MEM2MEM_DEV
	select VIDEOBUF2_DMA_CONTIG_INGENIC
	default n
	help
		This config composer use for v4l2 device
config FB_USING_CACHABLE
	bool "using cacheable framebuffers, will flush cache when call pan_display."
	depends on FB_INGENIC_STAGE
	default n
	help
		Using Cacheable mmap to userspace.
config FB_INGENIC_PAN_VSYNC_GATE
	bool "wait for a real vsync event before applying a pan_display frame switch"
	depends on FB_INGENIC_STAGE
	default n
	help
		DISPLAY-V1 prototype (NebulaOS display hardware analysis mission,
		2026-08-01): dpu_ctrl_rdma_change(), the function FBIOPAN_DISPLAY
		calls to switch the active scanout frame, never waits for the
		in-flight frame's scan-out to complete before writing the new
		frame's address - this can tear if userspace pans faster than the
		display refreshes. When enabled, ingenicfb_pan_display() waits
		(bounded, with a safe immediate-update fallback on timeout) for
		the next real vsync event before applying the switch, reusing the
		same vsync waitqueue and IRQ event that already drives
		FBIO_WAITFORVSYNC. Disabled by default - never enable this for a
		production build until live hardware testing confirms it does not
		regress the working display path (see
		docs/NEBULAOS_DISPLAY_LIVE_QUALIFICATION_PLAN.md).
```
